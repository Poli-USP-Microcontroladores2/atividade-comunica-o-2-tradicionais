## .pio/build/frdm_kl25z/Kconfig/arch/Kconfig
```kconfig
# Load Zephyr Arch Kconfig descriptions.
osource "/Users/anitapereira/.platformio/packages/framework-zephyr/arch/rx/Kconfig"
osource "/Users/anitapereira/.platformio/packages/framework-zephyr/arch/x86/Kconfig"
osource "/Users/anitapereira/.platformio/packages/framework-zephyr/arch/xtensa/Kconfig"
osource "/Users/anitapereira/.platformio/packages/framework-zephyr/arch/sparc/Kconfig"
osource "/Users/anitapereira/.platformio/packages/framework-zephyr/arch/riscv/Kconfig"
osource "/Users/anitapereira/.platformio/packages/framework-zephyr/arch/posix/Kconfig"
osource "/Users/anitapereira/.platformio/packages/framework-zephyr/arch/mips/Kconfig"
osource "/Users/anitapereira/.platformio/packages/framework-zephyr/arch/arm64/Kconfig"
osource "/Users/anitapereira/.platformio/packages/framework-zephyr/arch/arm/Kconfig"
osource "/Users/anitapereira/.platformio/packages/framework-zephyr/arch/arc/Kconfig"
```

## .pio/build/frdm_kl25z/Kconfig/boards/Kconfig.defconfig
```kconfig
# Load Zephyr board defconfig descriptions.
osource "C:/Users/alexa/.platformio/packages/framework-zephyr/boards/nxp/frdm_kl25z/Kconfig.defconfig"
```

## .pio/build/frdm_kl25z/Kconfig/boards/Kconfig.frdm_kl25z
```kconfig
# Load board Kconfig descriptions.
osource "/Users/anitapereira/.platformio/packages/framework-zephyr/boards/nxp/frdm_kl25z/Kconfig.frdm_kl25z"
```

## .pio/build/frdm_kl25z/Kconfig/boards/Kconfig.sysbuild
```kconfig
# Load Sysbuild board Kconfig descriptions.
osource "C:/Users/alexa/.platformio/packages/framework-zephyr/boards/nxp/frdm_kl25z/Kconfig.sysbuild"
```
